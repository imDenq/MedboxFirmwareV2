## main/Kconfig.projbuild
```kconfig
menu "Medbox Configuration"

    menu "WiFi Configuration"
        config MEDBOX_WIFI_SSID
            string "WiFi SSID"
            default "CPL_DENQ"
            help
                SSID du réseau WiFi.

        config MEDBOX_WIFI_PASSWORD
            string "WiFi Password"
            default "AZoote51420&"
            help
                Mot de passe du réseau WiFi.
    endmenu

    menu "MQTT Configuration"
        config MEDBOX_MQTT_BROKER_IP
            string "MQTT Broker Host"
            default "mqtt.medbox.theokaszak.fr"
            help
                Adresse du broker MQTT EMQX (IP ou nom de domaine).

        config MEDBOX_MQTT_BROKER_PORT
            int "MQTT Broker Port"
            default 1883
            help
                Port du broker MQTT (1883 pour TCP, 8883 pour TLS).

        config MEDBOX_MQTT_USE_TLS
            bool "Utiliser TLS"
            default n
            help
                Activer la connexion TLS/SSL au broker MQTT.

        config MEDBOX_MQTT_VERIFY_SERVER
            bool "Vérifier le certificat serveur"
            default y
            depends on MEDBOX_MQTT_USE_TLS
            help
                Vérifier le certificat du serveur (recommandé en production).

        config MEDBOX_MQTT_USE_CLIENT_CERT
            bool "Utiliser certificat client (mTLS)"
            default y
            depends on MEDBOX_MQTT_USE_TLS
            help
                Utiliser l'authentification par certificat client (mTLS).

        config MEDBOX_MQTT_USERNAME
            string "MQTT Username"
            default ""
            help
                Nom d'utilisateur MQTT (optionnel si mTLS activé).

        config MEDBOX_MQTT_PASSWORD
            string "MQTT Password"
            default ""
            help
                Mot de passe MQTT (optionnel si mTLS activé).

        config MEDBOX_MQTT_TOPIC_BASE
            string "Topic de base"
            default "medbox"
            help
                Topic de base pour la Medbox (ex: medbox/{uuid}/...).
    endmenu

    menu "Security Configuration"
        config MEDBOX_DEV_MODE
            bool "Mode Developpement (UUID de test)"
            default y
            help
                Utilise un UUID de test hardcode pour le developpement.
                DESACTIVER en production!

        config MEDBOX_DEV_UUID
            string "UUID de test"
            default "medbox-dev-001"
            depends on MEDBOX_DEV_MODE
            help
                UUID utilise en mode developpement.

        config MEDBOX_PROVISIONING_MODE
            bool "Mode Provisioning"
            default n
            depends on !MEDBOX_DEV_MODE
            help
                Active le mode provisioning pour injecter les certificats
                et l'UUID via le port série. DÉSACTIVER en production!

        config MEDBOX_ENABLE_SECURE_BOOT
            bool "Activer Secure Boot"
            default n
            help
                Active le Secure Boot ESP32. ATTENTION: irréversible une fois
                les efuses programmés!

        config MEDBOX_ENABLE_FLASH_ENCRYPTION
            bool "Activer Flash Encryption"
            default n
            help
                Active le chiffrement de la flash. ATTENTION: irréversible
                en mode RELEASE!
    endmenu

endmenu
```

## sdkconfig.defaults
```kconfig
# Medbox Firmware - Configuration par défaut

# Partition Table
CONFIG_PARTITION_TABLE_CUSTOM=y
CONFIG_PARTITION_TABLE_CUSTOM_FILENAME="partitions.csv"
CONFIG_PARTITION_TABLE_OFFSET=0x10000

# WiFi
CONFIG_ESP_WIFI_SOFTAP_SUPPORT=y

# MQTT
CONFIG_MQTT_PROTOCOL_5=y
CONFIG_MQTT_TRANSPORT_SSL=y

# TLS/mbedTLS
CONFIG_MBEDTLS_SSL_MAX_CONTENT_LEN=8192
CONFIG_MBEDTLS_CERTIFICATE_BUNDLE=y
CONFIG_MBEDTLS_CERTIFICATE_BUNDLE_DEFAULT_FULL=n
CONFIG_MBEDTLS_CERTIFICATE_BUNDLE_DEFAULT_CMN=y

# FreeRTOS
CONFIG_FREERTOS_HZ=1000
CONFIG_FREERTOS_TIMER_TASK_STACK_DEPTH=3072

# Log Level
CONFIG_LOG_DEFAULT_LEVEL_INFO=y
CONFIG_LOG_MAXIMUM_LEVEL_DEBUG=y

# Optimisations
CONFIG_COMPILER_OPTIMIZATION_SIZE=y

# ============================================
# SECURE BOOT V2 (Development Mode)
# ============================================
CONFIG_SECURE_BOOT=y
CONFIG_SECURE_BOOT_V2_ENABLED=y
CONFIG_SECURE_BOOT_BUILD_SIGNED_BINARIES=y
CONFIG_SECURE_BOOT_SIGNING_KEY="keys/secure_boot_signing_key.pem"
CONFIG_SECURE_SIGNED_ON_BOOT=y
CONFIG_SECURE_SIGNED_ON_UPDATE=y
CONFIG_SECURE_SIGNED_APPS=y

# ============================================
# FLASH ENCRYPTION (Development Mode)
# ============================================
CONFIG_SECURE_FLASH_ENC_ENABLED=y
CONFIG_SECURE_FLASH_ENCRYPTION_MODE_DEVELOPMENT=y

# ============================================
# NVS ENCRYPTION
# ============================================
CONFIG_NVS_ENCRYPTION=y

# ============================================
# Bootloader (increased size for security features)
# ============================================
CONFIG_BOOTLOADER_LOG_LEVEL_INFO=y

# Medbox Config - TLS activé
CONFIG_MEDBOX_MQTT_USE_TLS=y
CONFIG_MEDBOX_MQTT_VERIFY_SERVER=y
CONFIG_MEDBOX_MQTT_USE_CLIENT_CERT=y
CONFIG_MEDBOX_MQTT_BROKER_IP="185.157.245.46"
CONFIG_MEDBOX_MQTT_BROKER_PORT=8883
CONFIG_MEDBOX_MQTT_TOPIC_BASE="medbox/box"

# Mode dev actif (certificats embarqués)
CONFIG_MEDBOX_DEV_MODE=y
CONFIG_MEDBOX_DEV_UUID="945c1ffc-3801-4af1-bb51-bb1e1710abb1"
CONFIG_MEDBOX_PROVISIONING_MODE=n
```
